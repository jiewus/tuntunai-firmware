## main/Kconfig.projbuild
```kconfig
# 本文件只定义所有 TuntunLife 板型共享的产品配置项。板型由 CMake BOARD_TYPE 选择。
menu "TuntunLife Assistant"

config OTA_URL
    string "Default OTA URL"
    # 设备启动时向 TuntunLife 自有服务检查新固件并获取协议配置。
    default "https://api.tuntun.life/api/ota/moji2"

config TUNTUN_API_URL
    string "TuntunLife API URL"
    # 设备绑定、天气、备忘录和动态 MCP 能力统一使用的开放平台根地址。
    # 该服务对所有外部硬件开放；通过 menuconfig 可改为自建后端或留空禁用该组能力。
    default "https://api.tuntun.life"

choice
    prompt "Flash Assets"
    # 决定 idf.py flash 是否同时写入字体、表情和 WakeNet 模型资源分区。
    default FLASH_DEFAULT_ASSETS

    config FLASH_NONE_ASSETS
        bool "Do not flash assets"
    config FLASH_DEFAULT_ASSETS
        bool "Flash default Chinese assets"
    config FLASH_CUSTOM_ASSETS
        bool "Flash custom assets"
endchoice

config CUSTOM_ASSETS_FILE
    string "Custom Assets File"
    # 可使用 URL、绝对路径或相对 main/ 的路径。
    default "assets.bin"
    depends on FLASH_CUSTOM_ASSETS

choice WAKE_WORD_TYPE
    prompt "Wake Word"
    # 具体模型和 AFE 能力由板型 sdkconfig.defaults 选择。
    default USE_ESP_WAKE_WORD

    config WAKE_WORD_DISABLED
        bool "Disabled"
    config USE_ESP_WAKE_WORD
        bool "ESP-SR wake word"
endchoice

config SEND_WAKE_WORD_DATA
    bool "Send wake word audio data"
    # 命中唤醒词后，把检测窗口内的麦克风音频编码上传，并发送唤醒词 detect 事件。
    default n

config WAKE_WORD_BARGE_IN
    bool "Wake word barge-in during conversation"
    # 对话进行中（正在播放回复/正在监听）保持唤醒词检测，允许用“你好小智”随时打断并开始新对话。
    # 副作用：speaking 时麦克风会持续采集到扬声器回声，wakenet 需在背景音频下仍能识别。
    default y

config USE_AUDIO_DEBUGGER
    bool "Enable audio debugger"
    # 开启后会把麦克风 PCM 通过 UDP 发往下方配置的开发机地址。
    default n

config AUDIO_DEBUG_UDP_SERVER
    string "Audio debug UDP server"
    default "192.168.2.100:8000"
    depends on USE_AUDIO_DEBUGGER

config USE_HOTSPOT_WIFI_PROVISIONING
    bool
    # 本产品固定使用 SoftAP + 网页方式配置 Wi-Fi。
    default y

config RECEIVE_CUSTOM_MESSAGE
    bool "Enable custom server messages"
    default n

endmenu
```

## main/boards/echoear/sdkconfig.defaults
```kconfig
# EchoEar ESP32-S3-WROOM-1-N32R16 hardware defaults.
# Keep the EchoEar protocol bootstrap aligned with the Moji board. The official
# OTA response supplies the actual Xiaozhi MQTT/WebSocket credentials.
CONFIG_OTA_URL="https://api.tenclass.net/xiaozhi/ota/"
CONFIG_TUNTUN_API_URL="https://api.tuntun.life"

CONFIG_ESPTOOLPY_FLASHSIZE_32MB=y
CONFIG_ESPTOOLPY_FLASHMODE_QIO=y
CONFIG_ESP_DEFAULT_CPU_FREQ_MHZ_240=y

CONFIG_PARTITION_TABLE_CUSTOM=y
CONFIG_PARTITION_TABLE_CUSTOM_FILENAME="partitions/v2/16m.csv"
CONFIG_PARTITION_TABLE_OFFSET=0x10000

CONFIG_SPIRAM=y
CONFIG_SPIRAM_MODE_OCT=y
CONFIG_SPIRAM_SPEED_80M=y
CONFIG_SPIRAM_USE_MALLOC=y
CONFIG_FREERTOS_TASK_CREATE_ALLOW_EXT_MEM=y
CONFIG_SPIRAM_MALLOC_ALWAYSINTERNAL=16384
CONFIG_SPIRAM_MALLOC_RESERVE_INTERNAL=65536
CONFIG_SPIRAM_MEMTEST=n
CONFIG_MBEDTLS_EXTERNAL_MEM_ALLOC=y
CONFIG_MBEDTLS_DYNAMIC_FREE_CONFIG_DATA=y

CONFIG_ESP32S3_INSTRUCTION_CACHE_32KB=y
CONFIG_ESP32S3_DATA_CACHE_64KB=y
CONFIG_ESP32S3_DATA_CACHE_LINE_64B=y

CONFIG_CODEC_I2C_BACKWARD_COMPATIBLE=n

# Wi-Fi scan/connect callbacks run on sys_evt and exceed the IDF default stack.
# Keep the value used by the original EchoEar firmware.
CONFIG_ESP_SYSTEM_EVENT_TASK_STACK_SIZE=4096

CONFIG_LV_OS_NONE=y
CONFIG_LV_USE_CLIB_MALLOC=y
CONFIG_LV_USE_CLIB_STRING=y
CONFIG_LV_USE_CLIB_SPRINTF=y
CONFIG_LV_USE_IMGFONT=y
CONFIG_LV_USE_ASSERT_STYLE=y
CONFIG_LV_FONT_FMT_TXT_LARGE=y
CONFIG_LV_USE_FONT_COMPRESSED=n
CONFIG_LV_USE_FONT_PLACEHOLDER=n
CONFIG_LV_USE_LODEPNG=y
CONFIG_LV_USE_ANIMIMG=n
CONFIG_LV_USE_CALENDAR=n
CONFIG_LV_USE_CHART=n
CONFIG_LV_USE_KEYBOARD=n
CONFIG_LV_USE_LED=n
CONFIG_LV_USE_LIST=n
CONFIG_LV_USE_MENU=n
CONFIG_LV_USE_MSGBOX=n
CONFIG_LV_USE_SPAN=n
CONFIG_LV_USE_SPINBOX=n
CONFIG_LV_USE_SPINNER=n
CONFIG_LV_USE_TABVIEW=n
CONFIG_LV_USE_TILEVIEW=n
CONFIG_LV_USE_WIN=n
CONFIG_LV_BUILD_EXAMPLES=n
CONFIG_LV_BUILD_DEMOS=n

CONFIG_SR_WN_WN9S_NIHAOXIAOZHI=y
CONFIG_USE_ESP_WAKE_WORD=y
CONFIG_LIBC_NEWLIB=y
CONFIG_SEND_WAKE_WORD_DATA=y
CONFIG_WAKE_WORD_BARGE_IN=y
```

## main/boards/movecall-moji2-esp32c5/Kconfig.projbuild
```kconfig
menu "Tuntun Moji2 ESP32-C5"

choice DISPLAY_STYLE
    prompt "Display Style"
    default USE_DEFAULT_MESSAGE_STYLE

    config USE_DEFAULT_MESSAGE_STYLE
        bool "Default message style"
    config USE_WECHAT_MESSAGE_STYLE
        bool "WeChat message style"
endchoice

endmenu
```

## main/boards/movecall-moji2-esp32c5/sdkconfig.defaults
```kconfig
# Tuntun Moji2 ESP32-C5 board defaults. Keep chip and board wiring constraints here.
CONFIG_ESPTOOLPY_FLASHSIZE_16MB=y
CONFIG_ESPTOOLPY_FLASHMODE_QIO=y
CONFIG_ESP_DEFAULT_CPU_FREQ_MHZ_240=y

CONFIG_PARTITION_TABLE_CUSTOM=y
CONFIG_PARTITION_TABLE_CUSTOM_FILENAME="partitions/v2/16m.csv"
CONFIG_PARTITION_TABLE_OFFSET=0x10000

CONFIG_SPIRAM=y
CONFIG_SPIRAM_MODE_QUAD=y
CONFIG_SPIRAM_SPEED_80M=y
CONFIG_SPIRAM_USE_MALLOC=y
CONFIG_FREERTOS_TASK_CREATE_ALLOW_EXT_MEM=y
CONFIG_SPIRAM_MALLOC_ALWAYSINTERNAL=16384
CONFIG_SPIRAM_MALLOC_RESERVE_INTERNAL=32768

CONFIG_ESP_WIFI_STATIC_RX_BUFFER_NUM=3
CONFIG_ESP_WIFI_DYNAMIC_RX_BUFFER_NUM=6
CONFIG_ESP_WIFI_RX_BA_WIN=3
CONFIG_LWIP_TCPIP_RECVMBOX_SIZE=16
CONFIG_MBEDTLS_EXTERNAL_MEM_ALLOC=y
CONFIG_MBEDTLS_DYNAMIC_FREE_CONFIG_DATA=y

CONFIG_CODEC_I2C_BACKWARD_COMPATIBLE=n

# Moji2 圆屏使用 LVGL、外部 cbin 字体、PNG 和精简控件集。
CONFIG_LV_OS_NONE=y
CONFIG_LV_USE_CLIB_MALLOC=y
CONFIG_LV_USE_CLIB_STRING=y
CONFIG_LV_USE_CLIB_SPRINTF=y
CONFIG_LV_USE_IMGFONT=y
CONFIG_LV_USE_ASSERT_STYLE=y
CONFIG_LV_FONT_FMT_TXT_LARGE=y
CONFIG_LV_USE_FONT_COMPRESSED=n
CONFIG_LV_USE_FONT_PLACEHOLDER=n
CONFIG_LV_USE_LODEPNG=y
CONFIG_LV_USE_ANIMIMG=n
CONFIG_LV_USE_CALENDAR=n
CONFIG_LV_USE_CALENDAR_HEADER_ARROW=n
CONFIG_LV_USE_CALENDAR_HEADER_DROPDOWN=n
CONFIG_LV_USE_CHART=n
CONFIG_LV_USE_KEYBOARD=n
CONFIG_LV_USE_LED=n
CONFIG_LV_USE_LIST=n
CONFIG_LV_USE_MENU=n
CONFIG_LV_USE_MSGBOX=n
CONFIG_LV_USE_SPAN=n
CONFIG_LV_USE_SPINBOX=n
CONFIG_LV_USE_SPINNER=n
CONFIG_LV_USE_TABVIEW=n
CONFIG_LV_USE_TILEVIEW=n
CONFIG_LV_USE_WIN=n
CONFIG_LV_BUILD_EXAMPLES=n
CONFIG_LV_BUILD_DEMOS=n

CONFIG_SR_WN_WN9S_NIHAOXIAOZHI=y
CONFIG_USE_ESP_WAKE_WORD=y
```

## sdkconfig.defaults
```kconfig
# 优先缩小应用体积；MCP 的 variant/异常校验需要保留 C++ 异常和 RTTI。
CONFIG_COMPILER_OPTIMIZATION_SIZE=y
CONFIG_COMPILER_CXX_EXCEPTIONS=y
CONFIG_COMPILER_CXX_EXCEPTIONS_EMG_POOL_SIZE=1024
CONFIG_COMPILER_CXX_RTTI=y

# 启用双 OTA 回滚；新固件确认正常启动后由 Ota::MarkCurrentVersionValid() 标记有效。
# 开发构建必须保留启动镜像完整性校验；Secure Boot、Flash Encryption 和防降级由
# sdkconfig.release.defaults 仅在发布构建中启用，避免普通烧录意外写入不可逆 eFuse。
CONFIG_BOOTLOADER_COMPILER_OPTIMIZATION_PERF=y
CONFIG_BOOTLOADER_LOG_LEVEL_NONE=y
CONFIG_BOOTLOADER_APP_ROLLBACK_ENABLE=y

# 热点配网页面的请求头和 URI 上限。
CONFIG_HTTPD_MAX_REQ_HDR_LEN=2048
CONFIG_HTTPD_MAX_URI_LEN=2048

# 设备绑定及后续业务 API 的默认 HTTPS 根地址（开放的 TuntunLife 服务，所有外部硬件可接入）。
CONFIG_TUNTUN_API_URL="https://api.tuntun.life"

# 打开运行时间统计，供 SystemInfo 输出任务 CPU 占用。
CONFIG_ESP_TASK_WDT_TIMEOUT_S=10
CONFIG_FREERTOS_GENERATE_RUN_TIME_STATS=y
CONFIG_FREERTOS_USE_STATS_FORMATTING_FUNCTIONS=y

# 主任务需要容纳 JSON、状态切换和部分 OTA 调用栈；TLS 缓冲按需动态分配。
CONFIG_ESP_MAIN_TASK_STACK_SIZE=8192
CONFIG_MBEDTLS_DYNAMIC_BUFFER=y
CONFIG_MBEDTLS_SSL_KEEP_PEER_CERTIFICATE=n
CONFIG_ESP_WIFI_IRAM_OPT=n
CONFIG_ESP_WIFI_RX_IRAM_OPT=n
CONFIG_ESP_WIFI_DYNAMIC_RX_MGMT_BUFFER=y

# 手机热点的蜂窝出口可能使用小于 1500 的路径 MTU。限制 TCP MSS，避免较大的 TLS
# 握手分片在此类链路中被静默丢弃，导致特定 HTTPS 域名连接超时。
CONFIG_LWIP_TCP_MSS=1200

# 为实时 UDP 音频启用 socket 接收缓冲区配置，吸收短时网络抖动。
CONFIG_LWIP_SO_RCVBUF=y
CONFIG_LWIP_UDP_RECVMBOX_SIZE=24

# 收紧 Wi-Fi 缓冲数量以降低内部 RAM 占用；语音数据本身已有应用层有界队列。
CONFIG_ESP_WIFI_STATIC_RX_BUFFER_NUM=6
CONFIG_ESP_WIFI_DYNAMIC_RX_BUFFER_NUM=8
CONFIG_LIBC_NEWLIB_NANO_FORMAT=y
CONFIG_ESP_WIFI_ENTERPRISE_SUPPORT=n

# 禁用 TLS 重协商，避免当前网络抽象层的 ESP-SSL 兼容问题。
CONFIG_MBEDTLS_SSL_RENEGOTIATION=n
```
